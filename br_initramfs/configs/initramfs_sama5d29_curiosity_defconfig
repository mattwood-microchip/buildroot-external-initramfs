## br_initramfs/configs/initramfs_sama5d29_curiosity_defconfig
```kconfig
BR2_arm=y
BR2_cortex_a5=y
BR2_ARM_ENABLE_NEON=y
BR2_ARM_ENABLE_VFP=y
BR2_TOOLCHAIN_EXTERNAL=y
BR2_TOOLCHAIN_EXTERNAL_BOOTLIN=y
BR2_TOOLCHAIN_EXTERNAL_BOOTLIN_ARMV7_EABIHF_MUSL_BLEEDING_EDGE=y
BR2_DL_DIR="$(BASE_DIR)/../dl"
BR2_CCACHE=y
BR2_CCACHE_DIR="/tmp/br_initramfs_ccache"
BR2_ROOTFS_DEVICE_CREATION_DYNAMIC_MDEV=y
BR2_ROOTFS_OVERLAY="$(BR2_EXTERNAL_INITRAMFS_PATH)/board/microchip/sama5d29_curiosity/fs-overlay"
BR2_LINUX_KERNEL=y
BR2_LINUX_KERNEL_CUSTOM_TARBALL=y
BR2_LINUX_KERNEL_CUSTOM_TARBALL_LOCATION="$(call github,linux4microchip,linux,linux4microchip-2024.04)/linux-linux4microchip-2024.04.tar.gz"
BR2_LINUX_KERNEL_PATCH="$(BR2_EXTERNAL_INITRAMFS_PATH)/board/microchip/sama5d29_curiosity/0001-bootsplash-fix-video-glitch.patch"
BR2_LINUX_KERNEL_USE_CUSTOM_CONFIG=y
BR2_LINUX_KERNEL_CUSTOM_CONFIG_FILE="$(BR2_EXTERNAL_MCHP_PATH)/board/microchip/sama5/linux.config"
BR2_LINUX_KERNEL_DTS_SUPPORT=y
BR2_LINUX_KERNEL_CUSTOM_DTS_PATH="$(BR2_EXTERNAL_INITRAMFS_PATH)/board/microchip/sama5d29_curiosity/at91-sama5d29_curiosity.dts"
BR2_PACKAGE_EVTEST=y
BR2_TARGET_ROOTFS_INITRAMFS=y
# BR2_TARGET_ROOTFS_TAR is not set
```

## br_mainfs/board/microchip/sama5d29_curiosity/at91bootstrap_bootsplash_defconfig
```kconfig
CONFIG_CRYSTAL_24_000MHZ=y
CONFIG_CONSOLE_INDEX=0
CONFIG_DEBUG=y
CONFIG_DDR_SET_BY_DEVICE=y
CONFIG_DDR_AS4C128M32MD2A=y
CONFIG_SDCARD=y
CONFIG_LED_ON_BOARD=y
CONFIG_LED_R_ON_PIOA=y
CONFIG_LED_R_PIN=7
CONFIG_LED_G_ON_PIOA=y
CONFIG_LED_G_PIN=8
CONFIG_LED_B_ON_PIOA=y
CONFIG_LED_B_PIN=9
CONFIG_LCDC=y
CONFIG_LCDC_IOSET_2=y
CONFIG_LOGO=y
CONFIG_LOGO_SCALE="3"
```

## br_mainfs/configs/mainfs_sama5d29_curiosity_defconfig
```kconfig
BR2_arm=y
BR2_cortex_a5=y
BR2_ARM_ENABLE_NEON=y
BR2_ARM_ENABLE_VFP=y
BR2_TOOLCHAIN_EXTERNAL=y
BR2_TOOLCHAIN_EXTERNAL_BOOTLIN=y
BR2_DL_DIR="$(BASE_DIR)/../dl"
BR2_CCACHE=y
BR2_CCACHE_DIR="/tmp/br_ccache_mainfs"
BR2_PACKAGE_OVERRIDE_FILE=""
BR2_GLOBAL_PATCH_DIR="$(BR2_EXTERNAL_MAINFS_PATH)/patches"
BR2_ROOTFS_DEVICE_CREATION_DYNAMIC_EUDEV=y
BR2_TARGET_GENERIC_GETTY_TERM="vt102"
BR2_ROOTFS_OVERLAY="$(BR2_EXTERNAL_MAINFS_PATH)/board/microchip/sama5d29_curiosity/fs-overlay"
BR2_ROOTFS_POST_IMAGE_SCRIPT="$(BR2_EXTERNAL_MAINFS_PATH)/board/microchip/sama5d29_curiosity/post-image.sh"
BR2_ROOTFS_POST_SCRIPT_ARGS="$(BR2_EXTERNAL_MAINFS_PATH)/board/microchip/sama5d29_curiosity/genimage.cfg"
BR2_PACKAGE_EVTEST=y
BR2_PACKAGE_LIBDRM_INSTALL_TESTS=y
BR2_PACKAGE_LIBINPUT=y
BR2_PACKAGE_NCURSES_WCHAR=y
BR2_PACKAGE_NCURSES_TARGET_PROGS=y
BR2_PACKAGE_NANO=y
BR2_TARGET_ROOTFS_EXT2=y
BR2_TARGET_ROOTFS_EXT2_4=y
BR2_TARGET_ROOTFS_EXT2_SIZE="105M"
# BR2_TARGET_ROOTFS_TAR is not set
BR2_TARGET_AT91BOOTSTRAP3=y
BR2_TARGET_AT91BOOTSTRAP3_CUSTOM_GIT=y
BR2_TARGET_AT91BOOTSTRAP3_CUSTOM_REPO_URL="https://github.com/linux4sam/at91bootstrap.git"
BR2_TARGET_AT91BOOTSTRAP3_CUSTOM_REPO_VERSION="v4.0.9"
BR2_TARGET_AT91BOOTSTRAP3_USE_CUSTOM_CONFIG=y
BR2_TARGET_AT91BOOTSTRAP3_CUSTOM_CONFIG_FILE="$(BR2_EXTERNAL_MAINFS_PATH)/board/microchip/sama5d29_curiosity/at91bootstrap_bootsplash_defconfig"
BR2_TARGET_UBOOT=y
BR2_TARGET_UBOOT_BUILD_SYSTEM_KCONFIG=y
BR2_TARGET_UBOOT_CUSTOM_GIT=y
BR2_TARGET_UBOOT_CUSTOM_REPO_URL="https://github.com/linux4microchip/u-boot-mchp.git"
BR2_TARGET_UBOOT_CUSTOM_REPO_VERSION="linux4microchip-2024.04"
BR2_TARGET_UBOOT_BOARD_DEFCONFIG="sama5d29_curiosity_mmc"
BR2_TARGET_UBOOT_NEEDS_DTC=y
BR2_PACKAGE_HOST_BMAP_TOOLS=y
BR2_PACKAGE_HOST_GENIMAGE=y
BR2_PACKAGE_HOST_KMOD=y
BR2_PACKAGE_HOST_UBOOT_TOOLS=y
BR2_PACKAGE_HOST_UBOOT_TOOLS_ENVIMAGE=y
BR2_PACKAGE_HOST_UBOOT_TOOLS_ENVIMAGE_SOURCE="$(BR2_EXTERNAL_MAINFS_PATH)/board/microchip/sama5d29_curiosity/uboot-env.txt"
BR2_PACKAGE_HOST_UBOOT_TOOLS_ENVIMAGE_SIZE="0x4000"
BR2_PACKAGE_LIBPLANES=y
BR2_PACKAGE_EGT=y
BR2_PACKAGE_NOTO_FONTS=y
BR2_PACKAGE_INIT_NONE=y
```
